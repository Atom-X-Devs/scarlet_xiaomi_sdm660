## Documentation/devicetree/bindings/devfreq/mt8183-cci-devfreq.txt
```
* Mediatek CCI frequency device

Required properties:
- compatible: should contain "mediatek,mt8183-cci" for cci devfreq

- clocks: for cci devfreq

- clock-names: for cci devfreq driver to reference

- operating-points-v2: for cci devfreq opp table

Example:
	cci: cci {
		compatible = "mediatek,cci";
		clocks = <&apmixedsys CLK_APMIXED_CCIPLL>;
		clock-names = "cci_clock";
		operating-points-v2 = <&cci_opp>;
	};
```

## Documentation/devicetree/bindings/sound/max98390.txt
```
Maxim Integrated MAX98390 Speaker Amplifier

This device supports I2C.

Required properties:

 - compatible : "maxim,max98390"

 - reg : the I2C address of the device.

Optional properties:

- maxim,temperature_calib
  u32. The calculated temperature data was measured while doing the calibration. Data : Temp / 100 * 2^12

- maxim,r0_calib
  u32. This is r0 calibration data which was measured in factory mode.

Example:

codec: max98390@38 {
	compatible = "maxim,max98390";
	reg = <0x38>;
	maxim,temperature_calib = <1024>;
	maxim,r0_calib = <100232>;
};
```

## drivers/input/fingerprint/Kconfig
```kconfig
#
# Fingerprint driver configuration
#

config INPUT_FINGERPRINT
	bool "Fingerprints"
	help
	  Say Y here, and a list of supported fingerprints will be displayed.
	  This option doesn't affect the kernel.

	  If unsure, say Y.

config FPC_FINGERPRINT
	tristate "fpc1020 fingerprint driver"
	depends on INPUT_FINGERPRINT
	default n
	help
	add support for FPC fingerprint driver.

config GOODIX_FINGERPRINT
	tristate "generic goodix fingerprint driver"
	depends on INPUT_FINGERPRINT
	default n
	help
	add support for goodix fingerprint driver.
```

## drivers/input/touchscreen/nt36xxx/Kconfig
```kconfig
#
# Novatek NT36xxx touchscreen driver configuration
#

config TOUCHSCREEN_NT36XXX
	bool "Novatek NT36XXX support"
	help
	  Say Y here if you have a Novatek NT36xxx touchscreen connected
	  to your system.

	  If unsure, say N.
```

## drivers/input/touchscreen/nt36xxx_f7a/Kconfig
```kconfig
#
# Novatek NT36xxx touchscreen driver configuration
#

config TOUCHSCREEN_NT36XXX_F7A
	tristate "Novatek NT36xxx"
	help
	  Say Y here if you have a Novatek NT36xxx touchscreen connected
	  to your system on Redmi Note 7 (lavender).

	  If unsure, say N.
```

## drivers/xiaomi/Kconfig
```kconfig
config XIAOMI_SDM660
	bool "Xiaomi SDM660"
	depends on ARCH_SDM660
	help
	  Support for Xiaomi SDM660 devices.

if XIAOMI_SDM660
source "drivers/xiaomi/input/Kconfig"
endif

config LONGCHEER
	bool "Longcheer board"
	select XIAOMI_SDM660
	help
	  Support for Longcheer boards.

config MI
	bool "Mi board"
	select XIAOMI_SDM660
	help
	  Support for Mi boards.

config XIAOMI_LAVENDER
	bool "Xiaomi lavender board"
	select LONGCHEER
	help
	  Support for Xiaomi Redmi Note 7.

config XIAOMI_TULIP
	bool "Xiaomi tulip board"
	select LONGCHEER
	help
	  Support for Xiaomi Redmi Note 6 Pro.

config XIAOMI_WHYRED
	bool "Xiaomi whyred board"
	select LONGCHEER
	help
	  Support for Xiaomi Redmi Note 5 (Pro).

config XIAOMI_WAYNE
	bool "Xiaomi wayne board"
	select LONGCHEER
	help
	  Support for Xiaomi MI A2 and Mi 6X.

config XIAOMI_JASON
	bool "Xiaomi jason board"
	select MI
	help
	  Support for Xiaomi Mi Note 3.

config XIAOMI_PLATINA
	bool "Xiaomi platina board"
	select MI
	help
	  Support for Xiaomi Mi 8 Lite.

config XIAOMI_CLOVER
	bool "Xiaomi clover board"
	select MI
	help
	  Support for Xiaomi Mi Pad 4.

config XIAOMI_NEWCAM
	bool "Xiaomi new camera blobs"
	depends on XIAOMI_SDM660
	help
	  Support for Xiaomi new camera blobs.

config XIAOMI_OLDCAM
	bool "Xiaomi old camera blobs"
	depends on XIAOMI_SDM660
	help
	  Support for Xiaomi old camera blobs.

config XIAOMI_OSSCAM
	bool "Xiaomi oss camera blobs"
	depends on XIAOMI_SDM660
	help
	  Support for Xiaomi oss camera blobs.
```

## drivers/xiaomi/input/Kconfig
```kconfig
if INPUT

config INPUT_HALL_SENSOR
	tristate "hall sensor support"
	help
	  Say Y here if you have a hall sensor.

	  If unsure, say N.

source "drivers/xiaomi/input/fingerprint/Kconfig"

source "drivers/xiaomi/input/touchscreen/Kconfig"

endif
```

## drivers/xiaomi/input/fingerprint/Kconfig
```kconfig
#
# Fingerprint driver configuration
#

config INPUT_FINGERPRINT
	bool "Fingerprints"
	help
	  Say Y here, and a list of supported fingerprints will be displayed.
	  This option doesn't affect the kernel.

	  If unsure, say Y.

config FPC_FINGERPRINT
	tristate "fpc1020 fingerprint driver"
	depends on INPUT_FINGERPRINT
	help
	 This adds support for fpc1020 fingerprint driver.
```

## drivers/xiaomi/input/touchscreen/Kconfig
```kconfig
config TOUCHSCREEN_COMMON
	bool "Common touchscreen interface to interact with userspace"
	depends on INPUT_TOUCHSCREEN
	help
	  Say Y here if you want to control touchpanel features via
	  /sys/touchpanel.

	  If unsure, say N.
```
