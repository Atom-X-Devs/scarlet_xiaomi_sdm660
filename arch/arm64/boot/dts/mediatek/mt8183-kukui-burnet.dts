// SPDX-License-Identifier: (GPL-2.0 OR MIT)
/*
 * Copyright 2020 Google LLC
 */

/dts-v1/;
#include "mt8183-kukui-jacuzzi.dtsi"
#include "mt8183-kukui-audio-ts3a227e.dtsi"

/ {
	model = "Google burnet board";
	compatible = "google,burnet", "mediatek,mt8183";
};

&mt6358codec {
	mediatek,dmic-mode = <1>; /* one-wire */
};

&touchscreen {
	status = "okay";

	compatible = "hid-over-i2c";
	reg = <0x2c>;
	interrupt-parent = <&pio>;
	interrupts = <155 IRQ_TYPE_LEVEL_LOW>;
	pinctrl-names = "default";
	pinctrl-0 = <&touchscreen_pins>;

	post-power-on-delay-ms = <10>;
	hid-descr-addr = <0x0020>;
};
