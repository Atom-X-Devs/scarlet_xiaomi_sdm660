// SPDX-License-Identifier: (GPL-2.0 OR MIT)
/*
 * Copyright 2019 Bitland Information Technology Co.LTD
 *
 * SKU: 0x20 => 32
 *  - bits 7..4: Panel ID: 0x2 (BOE)
 */

/dts-v1/;
#include "mt8183-kukui-kodama.dtsi"
#include "mt8183-kukui-kodama-panel-boe.dtsi"

/ {
	model = "MediaTek kodama sku32 board";
	compatible = "google,kodama-sku32", "google,kodama", "mediatek,mt8183";
};
