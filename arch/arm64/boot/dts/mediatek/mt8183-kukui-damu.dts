// SPDX-License-Identifier: (GPL-2.0 OR MIT)
/*
 * Copyright 2019 Google LLC
 */

/dts-v1/;
#include "mt8183-kukui-jacuzzi.dtsi"
#include "mt8183-kukui-audio-da7219.dtsi"

/ {
	model = "Google damu board";
	compatible = "google,damu", "mediatek,mt8183";
};

&cpu_thermal {
	sustainable-power = <4500>; /* milliwatts */
};
